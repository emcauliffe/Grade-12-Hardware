;
; Timer2CTC.asm
;
; Created: 2018-03-02 9:00:59 AM
; Author : Ethan McAuliffe
;


; Replace with your application code
#include "prescalers.h"
.def toggle = r17
.org 0x0000
	rjmp reset

.org 0x000E
	rjmp TIM2_COMPA
	
reset:
	cli

	ldi r17,1<<PB3

	ldi	r16, T2ps1024	;set prescaler of 1024 for timer 2 ...
	sts TCCR2B,r16		;store into register for prescalers

	ldi r16,0x02		;set Mode 2:CTC
	sts	TCCR2A,r16		;store into register for mode

	ldi r16,123			;prepare for 63Hz (value the timer will count until)
	sts ORC2A,r16		;store into register

	ldi r16,1<<PB3		;
	out DDRB,r16		;

	ldi r16,1<<OCIE2A	;enable timer interrupt
	sts	TIMSK2,r16		;store into timer 2 enable register

	sei
	
	rcall delay

	clr r15				;
	sts	TIMSK2,r16		;


wait:
	rjmp wait

TIM2_COMPA:
	in r16,PORTB
	eor r16,r17
	out PORTB,r16
	reti

delay:
; Generated by delay loop calculator
; at http://www.bretmulvey.com/avrdelay.html
;
; Delay 40 000 000 cycles
; 2s 500ms at 16 MHz

    ldi  r18, 203
    ldi  r19, 236
    ldi  r20, 133
L1: dec  r20
    brne L1
    dec  r19
    brne L1
    dec  r18
    brne L1
    nop
ret
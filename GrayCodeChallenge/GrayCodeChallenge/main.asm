; GrayCodeChallenge.asm
;
; Created: 2018-01-15 8:57:57 AM
; Author : Ethan McAuliffe
;


; Replace with your application code
.def	iterate = r24
.def	temp  = r25
.def	three = r23
.def	threeTens = r22

.cseg
.org 0x0000
   rjmp  reset
;segment table format: ;gfab_cde.
.org 0x0010
grayStart:
  .DB	0,1,3,2,7,6,4,5,15,14,12,13,8,9,11,10 
grayEnd:
reset:
	ldi   r16, low(RAMEND)			;ALL assembly code should start by
	out   spl,r16					; setting the Stack Pointer to 
	ldi   r16, high(RAMEND)			; the end of SRAM to support
	out   sph,r16					; function calls, etc.
	ldi   xl,low(grayStart<<1)		;position X and Y pointers to the
	ldi   xh,high(grayStart<<1)		; start and end addresses of 
	ldi   yl,low(grayEnd<<1)		; our data table, respectively
	ldi   yh,high(grayEnd<<1)		;
	movw  z,x						;start Z pointer off at the start address of the table.
	
	ldi r16,0x1E
	out DDRD,r16					
	ldi r16,0x07
	out DDRB,r16					;pins to control transistors
	ldi r16,0x0F
	out DDRC,r16					;pins to control 7-segment driver    

collect:
	clr r16
	clr r17
	clr r18
	in r16,PIND						;store input from rotary encoder
	lsr r16							;shift right to get gray code
	movw z,r16						;move to element the gray code is in binary
	add zl,xl
	lpm r18,z						;store fetched binary value

convert:
	mov r16,r18
	ldi iterate, 8
	ldi three, 0x03
	ldi threeTens, 0x30
	clr r17
	clr r18

loop:
   rol r16
   rol r17
   rol r18							;shift value and BCD registers with carry
   dec iterate						
   breq pov							;jump to POV if there are no bits left to convert

   mov temp, r17					
   andi temp, 0x0F					
   cpi temp, 0x05			
   brlo tens						;skip to tens if value is less than 5		
   add r17,three					;otherwise add three
tens:
   cpi temp, 0x50			
   brlo hundreds
   add r17,threeTens
hundreds:
   andi temp, 0x0F
   cpi temp, 0x50			
   brlo loop
   add r18, three
rjmp loop

pov:
	out PORTC,r18					;output hundreds value
	ldi r16,0x04
	out PORTB,r16					;enable hundreds 7-seg disp
	rcall delay
	lsr r16

	swap r17
	out PORTC,r17					;output tens value
	out PORTB,r16					;enable tens 7-seg disp
	rcall delay
	lsr r16

	swap r17
	out PORTC,r17					;output ones value
	out PORTB,r16					;enable ones 7-seg disp
	rcall delay
rjmp collect

delay:
; Generated by delay loop calculator
; at http://www.bretmulvey.com/avrdelay.html
;
; Delay 16 000 cycles
; 1ms at 16 MHz

    ldi  r19, 21
    ldi  r20, 199
L1: dec  r20
    brne L1
    dec  r19
    brne L1
ret
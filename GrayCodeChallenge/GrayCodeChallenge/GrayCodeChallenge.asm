;
; GrayCodeChallenge.asm
;
; Created: 2018-01-15 8:57:57 AM
; Author : Ethan McAuliffe
;


; Replace with your application code
.def	times = r24
.def	temp  = r25
.def	three = r23
.def	threeO = r22

.cseg
.org 0x0000
   rjmp  reset
;segment table format: ;gfab_cde.
.org 0x10
grayStart:
  .DB	0,1,3,2,7,6,4,5,15,14,12,13,8,9,11,10 
grayEnd:
reset:
	ldi   r16, low(RAMEND)			;ALL assembly code should start by
	out   spl,r16					; setting the Stack Pointer to 
	ldi   r16, high(RAMEND)			; the end of SRAM to support
	out   sph,r16					; function calls, etc.
	ldi   xl,low(grayStart<<1)	;position X and Y pointers to the
	ldi   xh,high(grayStart<<1)	; start and end addresses of 
	ldi   yl,low(grayEnd<<1)	; our data table, respectively
	ldi   yh,high(grayEnd<<1)	;
	movw  z,x						;start Z pointer off at the start address of the table.
	
	ldi r16,0x1E
	out DDRD,r16
	ldi r16,0x07
	out DDRB,r16
	ldi r16,0x0F
	out DDRC,r16
	clr r16     ;set I/O Direction

collect:
	clr r16
	clr r17
	clr r18
	in r16,PIND
	lsr r16
	movw z,r16
	adiw z,0x20
	lpm r18,z

convert:
	mov r16,r18
	ldi times, 8
	ldi three, 0x03
	ldi threeO, 0x30
	clr r17
	clr r18

repeat:
   rol r16
   rol r17
   rol r18
   dec times
   breq pov

   mov temp, r17
   andi temp, 0x0F
   cpi temp, 0x05			
   brlo tens
   add r17,three
tens:
   cpi temp, 0x50			
   brlo hundreds
   add r17,threeO
hundreds:
   andi temp, 0x0F
   cpi temp, 0x50			
   brlo repeat
   add r18, three
rjmp repeat

pov:	
	out PORTC,r18
	ldi r16,0x04
	out PORTB,r16
	rcall delay
	lsr r16

	swap r17
	out PORTC,r17
	swap r17
	out PORTB,r16
	rcall delay
	lsr r16

	out PORTC,r17
	out PORTB,r16
	rcall delay
	rjmp collect

delay:
; Generated by delay loop calculator
; at http://www.bretmulvey.com/avrdelay.html
;
; Delay 160 000 cycles 
; 10ms at 16 MHz

    ldi  r19, 208
    ldi  r20, 202
L1: dec  r20
    brne L1
    dec  r19
    brne L1
    nop
ret